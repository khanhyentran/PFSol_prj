## rza-vin/Kconfig
```kconfig
config VIDEO_RZA_CSI2
	tristate "RZA MIPI CSI-2 Receiver"
	depends on VIDEO_V4L2 && VIDEO_V4L2_SUBDEV_API && OF
	depends on ARCH_RENESAS || COMPILE_TEST
	select V4L2_FWNODE
	---help---
	  Support for Renesas RZA MIPI CSI-2 receiver.
	  Supports RZA SoCs.

	  To compile this driver as a module, choose M here: the
	  module will be called rcar-csi2.

config VIDEO_RZA_VIN
	tristate "RZA Video Input (VIN) Driver"
	depends on VIDEO_V4L2 && VIDEO_V4L2_SUBDEV_API && OF && HAS_DMA && MEDIA_CONTROLLER
	depends on ARCH_RENESAS || COMPILE_TEST
	select VIDEOBUF2_DMA_CONTIG
	select V4L2_FWNODE
	---help---
	  Support for Renesas R-Car Video Input (VIN) driver.
	  Supports R-Car Gen2 and Gen3 SoCs.

	  To compile this driver as a module, choose M here: the
	  module will be called rcar-vin.

config VIDEO_RZA_VIN_DEBUG
	bool "RZA VIN overflow debug messages"
	depends on VIDEO_RZA_VIN
	---help---
	  Enable debug overflow messages on R-Car Video
	  Input driver.
	  If you set to enable, When an overflow occurred,
	  a debug overflow message is output.
```
